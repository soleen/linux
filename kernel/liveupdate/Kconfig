## kernel/liveupdate/Kconfig
```kconfig
# SPDX-License-Identifier: GPL-2.0-only

menu "Live Update and Kexec HandOver"

config KEXEC_HANDOVER
	bool "kexec handover"
	depends on ARCH_SUPPORTS_KEXEC_HANDOVER && ARCH_SUPPORTS_KEXEC_FILE
	select MEMBLOCK_KHO_SCRATCH
	select KEXEC_FILE
	select LIBFDT
	select CMA
	help
	  Allow kexec to hand over state across kernels by generating and
	  passing additional metadata to the target kernel. This is useful
	  to keep data or state alive across the kexec. For this to work,
	  both source and target kernels need to have this option enabled.

config KEXEC_HANDOVER_DEBUG
	bool "Enable Kexec Handover debug checks"
	depends on KEXEC_HANDOVER
	help
	  This option enables extra sanity checks for the Kexec Handover
	  subsystem. Since, KHO performance is crucial in live update
	  scenarios and the extra code might be adding overhead it is
	  only optionally enabled.

config KEXEC_HANDOVER_DEBUGFS
	bool "kexec handover debugfs interface"
	default KEXEC_HANDOVER
	depends on KEXEC_HANDOVER
	select DEBUG_FS
	help
	  Allow to control kexec handover device tree via debugfs
	  interface, i.e. finalize the state or aborting the finalization.
	  Also, enables inspecting the KHO fdt trees with the debugfs binary
	  blobs.

config KEXEC_HANDOVER_ENABLE_DEFAULT
	bool "Enable kexec handover by default"
	depends on KEXEC_HANDOVER
	help
	  Enable Kexec Handover by default. This avoids the need to
	  explicitly pass 'kho=on' on the kernel command line.

	  This is useful for systems where KHO is a prerequisite for other
	  features, such as Live Update, ensuring the mechanism is always
	  active.

	  The default behavior can still be overridden at boot time by
	  passing 'kho=off'.

config LIVEUPDATE
	bool "Live Update Orchestrator"
	depends on KEXEC_HANDOVER
	help
	  Enable the Live Update Orchestrator. Live Update is a mechanism,
	  typically based on kexec, that allows the kernel to be updated
	  while keeping selected devices operational across the transition.
	  These devices are intended to be reclaimed by the new kernel and
	  re-attached to their original workload without requiring a device
	  reset.

	  Ability to handover a device from current to the next kernel depends
	  on specific support within device drivers and related kernel
	  subsystems.

	  This feature primarily targets virtual machine hosts to quickly update
	  the kernel hypervisor with minimal disruption to the running virtual
	  machines.

	  If unsure, say N.

config LIVEUPDATE_MEMFD
	bool "Live update support for memfd"
	depends on LIVEUPDATE
	depends on MEMFD_CREATE
	depends on SHMEM
	default LIVEUPDATE
	help
	  Enable live update support for memfd regions. This allows preserving
	  memfd-backed memory across kernel live updates.

	  This can be used to back VM memory with memfds, allowing the guest
	  memory to persist, or for other user workloads needing to preserve
	  pages.

	  If unsure, say N.

config LIVEUPDATE_GUEST_MEMFD
	bool "Live update support for guest_memfd"
	depends on LIVEUPDATE
	depends on KVM_GUEST_MEMFD
	default LIVEUPDATE
	help
	  Enable live update support for KVM guest_memfd files. This allows
	  preserving VM Memory backed by guest_memfd file across kernel live
	  updates.

	  This can only be used for the guest_memfd that are fully-shared
	  and pre-faulted.

	  If unsure, say N.

config ARCH_SUPPORTS_LIVEUPDATE_CPU
	bool

config LIVEUPDATE_CPU
	bool "Live update support for preserved CPUs"
	depends on LIVEUPDATE
	depends on ARCH_SUPPORTS_LIVEUPDATE_CPU
	depends on HOTPLUG_CPU
	help
	  Enable live update support for physical CPU preservation.

	  This feature allows physical CPU cores to be preserved across
	  kexec-based live updates without undergoing a hardware reset or
	  full kernel offline/online cycle.

	  When a core is preserved, it is taken down through CPU hotplug
	  and parked in a small runtime in preserved memory. Its stack and
	  page tables are handed over across kexec using KHO. The incoming
	  kernel finds preserved cores during early boot and does not
	  bring them up in smp_init(); they are returned to Linux when
	  userspace retrieves and finishes the LUO session.

	  This is a building block for live updating virtual machine
	  hosts without pausing the guests.

	  Preservation lifecycle is managed from userspace via LUO sessions
	  associated with /sys/devices/system/cpu/cpu<N>/preserve file
	  descriptors, and monitored via sysfs.

	  If unsure, say N.

config LIVEUPDATE_ONCORE
	bool "On-core scheduler for preserved CPUs"
	depends on LIVEUPDATE_CPU
	help
	  Run kernel jobs on CPUs that are preserved across a live update
	  while the rest of the system goes through kexec. The CPUs of a
	  live update session share a minimal scheduler in the preserved
	  runtime: a job that has a CPU to itself runs tickless, more jobs
	  than CPUs are time-sliced.

	  Users of the scheduler, such as the KVM Caretaker, select this
	  option.

	  If unsure, say N.

config LIVEUPDATE_ONCORE_TEST
	bool "Test driver for On-Core scheduler"
	depends on LIVEUPDATE_ONCORE
	select DEBUG_FS
	help
	  Enable a built-in test driver (/sys/kernel/debug/oncore_test) and
	  Live Update file handler ("oncore-test-v1") for exercising the
	  On-Core session and scheduler framework across intra-kernel cancel
	  loops and kexec live updates.

	  If unsure, say N.

endmenu
```
